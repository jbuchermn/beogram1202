## esp8266-beogram/main/Kconfig.projbuild
```kconfig
menu "Beogram1202-esp8266"
    config BG_ENABLE_HTTP_SERVER
        bool "Enable wifi http server"

    config BG_WIFI_SSID
        string "WiFi SSID"
        default "ssid"
        help
            SSID

    config BG_WIFI_PASSWORD
        string "WiFi Password"
        default "password"
        help
            Password for WiFi connection

    config BG_HTTP_PORT
        int "HTTP port"
        default 80

    config BG_ENABLE_UART
        bool "Enable UART logging and live-tuning (74880 8N1)"
        default false

endmenu
```

## esp8266/main/Kconfig.projbuild
```kconfig
menu "Beogram1202-esp8266"
    config BG_WIFI_SSID
        string "WiFi SSID"
        default "ssid"
        help
            SSID
    config BG_WIFI_PASSWORD
        string "WiFi Password"
        default "password"
        help
            Password for WiFi connection

    config BG_ENABLE_UART
        bool "Enable UART logging and live-tuning (74880 8N1)"

endmenu
```
